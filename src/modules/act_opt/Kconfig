## src/modules/act_opt/Kconfig
```kconfig
menuconfig MODULES_ACT_OPT
  bool "act_opt"
  default n
  ---help---
    Enable support for act_opt
```

## src/modules/att_ctrl/Kconfig
```kconfig
menuconfig MODULES_ATT_CTRL
  bool "att_ctrl"
  default n
  ---help---
    Enable support for att_ctrl
```

## src/modules/fauav_ctrl/Kconfig
```kconfig
menuconfig MODULES_FAUAV_CTRL
  bool "fauav_ctrl"
  default n
  ---help---
    Enable support for fauav_ctrl
```

## src/modules/fault/Kconfig
```kconfig
menuconfig MODULES_FAULT
  bool "fault"
  default n
  ---help---
    Enable support for fault
```

## src/modules/pos_ctrl/Kconfig
```kconfig
menuconfig MODULES_POS_CTRL
  bool "pos_ctrl"
  default n
  ---help---
    Enable support for pos_ctrl
```

## src/modules/servo_ctrl/Kconfig
```kconfig
menuconfig MODULES_SERVO_CTRL
  bool "servo_ctrl"
  default n
  ---help---
    Enable support for servo_ctrl
```

## src/modules/vel_ctrl/Kconfig
```kconfig
menuconfig MODULES_VEL_CTRL
  bool "vel_ctrl"
  default n
  ---help---
    Enable support for vel_ctrl
```
